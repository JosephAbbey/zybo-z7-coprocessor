/ {
	amba_pl: amba_pl {
		ranges;
		compatible = "simple-bus";
		#address-cells = <1>;
		#size-cells = <1>;
		axi_gpio_output_0: axi_gpio_output@43c00000 {
			xlnx,rable = <0>;
			compatible = "xlnx,axi-gpio-output-1.0";
			status = "okay";
			clock-names = "s_axi_aclk";
			xlnx,ip-name = "axi_gpio_output";
			xlnx,gpio-width = <4>;
			xlnx,edk-iptype = "PERIPHERAL";
			reg = <0x43c00000 0x10000>;
			clocks = <&clkc 15>;
			xlnx,name = "axi_gpio_output_0";
		};
	};
};
